#define IR_1    0xA2
#define IR_2    0x62
#define IR_3    0xE2
#define IR_4    0x22
#define IR_5    0x2
#define IR_6    0xC2
#define IR_7    0xE0
#define IR_8    0xA8
#define IR_9    0x90
#define IR_STAR 0x68
#define IR_0    0x98
#define IR_HASH 0xB0
#define IR_UP   0x18
#define IR_LEFT 0x10
#define IR_OK   0x38
#define IR_RIGHT 0x5A
#define IR_DOWN 0x4A


#include <GyverOLED.h>
#include <NecDecoder.h>
#include <Servo.h>
Servo myservo;
NecDecoder ir;
GyverOLED<SSD1306_128x64, OLED_NO_BUFFER> oled;

const uint8_t bitmap_64x64[] PROGMEM = {
	0x00, 0x00, 0x00, 0x00, 0x00, 0x00, 0x00, 0x00, 0x00, 0x00, 0x00, 0x00,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 0x00, 
	0x00, 0x00, 0x00, 0x00, 0x00, 0x00, 0x00, 0x00, 0x00, 0x00, 0x00, 0x00,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 0x00, 
	0x00, 0x00, 0x00, 0x00, 0x00, 0x00, 0x00, 0x80, 0xC0, 0xE0, 0xF0, 0xF8,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 0x00, 
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	0xFF, 0xFF, 0xFF, 0xFF, 0xFF, 0xFF, 0xFF, 0xFF, 0x7F, 0x7F, 0x3F, 0x1F,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 0x7F, 
};

bool laser_sost = false; 
int servocorner = 0;
bool communism_display = false;
int last_button = 0;

int tonePin = 5;
int LASER = 4;

void irIsr() {
  ir.tick();
}

void setup() {
  Serial.begin(9600);
  myservo.attach(3); // servo pin
  attachInterrupt(0, irIsr, FALLING); // remote pin 
  pinMode(LASER, OUTPUT); // laser pin
  // put your setup code here, to run once:
  oled.init();        // инициализация
  oled.clear();       // очистка
  oled.update();
}




void desplay_std(){
  oled.home();
  oled.print("Laser: ");
  switch (laser_sost){
    case false: 
      oled.print("Off");
      break;
    case true:
      oled.print("On ");
      break;
  } 
  
  oled.setCursor(0, 2);
  oled.print("Logo :");
  switch (communism_display){
    case false: 
      oled.print("Off");
      break;
    case true:
      oled.print("On ");
      break;
  } 
  oled.setCursor(0, 3);
  oled.print("Servo: ");
  oled.print(servocorner);
  oled.print(" ");
  oled.setCursor(0, 4);
  oled.print("Button: ");  
  oled.print(last_button); 
}

void loop() {
  desplay_std();


  if (ir.available()) {
    switch (ir.readCommand()) {
      // выводим в порт, тут может быть ваш код
      case IR_1: // laser
        Serial.println("Pressed 1");
        switch(laser_sost){
          case false:
            laser_sost = true;
            digitalWrite(LASER, HIGH);
            Serial.println("case false");
            oled.update();
            break;
          case true:
            laser_sost = false;
            digitalWrite(LASER, LOW);
            Serial.println("case true");
            break;
        }
        oled.update();
        break;
      case IR_2: 
        Serial.println("Pressed 2"); 
        switch(communism_display){
          case false:
            communism_display = true;
            Serial.println("case false");
            oled.clear();
            oled.drawBitmap(64, 0, bitmap_64x64, 64, 64, BITMAP_NORMAL, BUF_ADD);
            oled.update();
            break;
          case true:
            communism_display = false;
            oled.clear();
            Serial.println("case true");
            break;
        }
        oled.update();
        break;
      case IR_3: 
        last_button = 3; 
        oled.update();
        
        break;
      case IR_4: 
        last_button = 4; 
        oled.update();
        break;
      case IR_5: 
        last_button = 5; 
        oled.update();
        break;
      case IR_6: 
        last_button = 5; 
        oled.update();
        break;
      case IR_7: 
        last_button = 7; 
        oled.update();
        break;
      case IR_8: 
        last_button = 8; 
        oled.update();
        break;
      case IR_9: 
        last_button = 9; 
        oled.update();
        break;
      case IR_STAR: 
        Serial.println("Pressed *"); 
        oled.update();
        break;
      case IR_0: 
        last_button = 0; 
        oled.update();
        break;
      case IR_HASH: 
        Serial.println("Pressed #"); 
        oled.update();
        break;
      case IR_UP: 
        Serial.println("Pressed up"); 
        oled.update();
        break;
      case IR_LEFT: 
        if (servocorner > 0){
          servocorner -= 10;
          myservo.write(servocorner);
        }
        else{
          tone(tonePin, 1000);
          delay(50);
        }
        noTone(tonePin);
        oled.update();
        break;
      case IR_OK: 
        Serial.println("Pressed ok"); 
        oled.update();
        break;
      case IR_RIGHT: 
        Serial.println("Pressed right");
        if (servocorner < 180){
          servocorner += 10;
          myservo.write(servocorner);
        }
        else{
          tone(tonePin, 1000);
          delay(50);
        } 
        noTone(tonePin);

        oled.update();
        break;
      case IR_DOWN: 
        Serial.println("Pressed down"); 
        oled.update();
        break;
    }
  }
}
